## config/west.yml
```yaml
manifest:
  remotes:
    - name: zmk
      url-base: https://github.com/zmkfirmware
    - name: badjeff
      url-base: https://github.com/badjeff
    - name: yangxing
      url-base: https://github.com/yangxing844
  projects:
    - name: zmk
      remote: zmk
      revision: v0.2.1
      import: app/west.yml
    - name: zmk-pmw3610-driver
      remote: badjeff
      revision: main
      path: modules/pmw3610
    - name: zmk-split-peripheral-input-relay
      remote: badjeff
      revision: main
      path: modules/split-peripheral-input-relay
    - name: zmk-input-behavior-listener
      remote: badjeff
      revision: main
      path: modules/input-behavior-listener
    - name: zmk-lpm009m360a-driver
      remote: yangxing
      revision: master
  self:
    path: config
```
